## faraday/image/external/Config.in
```kconfig
source "$BR2_EXTERNAL_FARADAY_PATH/package/faraday/Config.in"
source "$BR2_EXTERNAL_FARADAY_PATH/package/rpi-ovmerge/Config.in"
```

## faraday/image/external/package/opensigner-pi/Config.in
```kconfig
config BR2_PACKAGE_OPENSIGNER_PI
	bool "opensigner-pi"
	help
	  Install the prebuilt app as /usr/bin/opensigner-pi, the name the
	  inittab starts.

	  The binary is not built here: `just faraday-pi-bin` (or
	  `just faraday-stick-bin`) cross-compiles it on the host as a
	  static executable and the image build mounts it into the
	  container. Buildroot never sees the Rust toolchain.

if BR2_PACKAGE_OPENSIGNER_PI

config BR2_PACKAGE_OPENSIGNER_PI_BINARY
	string "path to the prebuilt binary"
	default "/binary/faraday"
	help
	  Absolute path, inside the build container, of the static
	  binary faraday.just built.

endif
```

## faraday/image/external/package/rpi-ovmerge/Config.in
```kconfig
config BR2_PACKAGE_HOST_RPI_OVMERGE
	bool "host rpi-ovmerge"
	help
	  Raspberry Pi's ovmerge, which merges device tree overlay sources
	  and their parameters into one overlay with no parameters.

	  https://github.com/raspberrypi/utils (ovmerge/)
```

## faraday/image/external/package/waveshare-28dpi-overlays/Config.in
```kconfig
config BR2_PACKAGE_WAVESHARE_28DPI_OVERLAYS
	bool "waveshare-28dpi-overlays"
	help
	  Waveshare's device tree overlay for the 2.8inch DPI LCD's touch
	  controller.

	  Downloaded from Waveshare's own file server, the pack their wiki
	  page links: https://www.waveshare.com/wiki/2.8inch_DPI_LCD
	  Only the Goodix touch controller on its bit-banged i2c bus is
	  taken; build.sh puts it in the initramfs as the 2.8-inch's touch
	  overlay (docs/IMAGES.md §3.3).
```

## opensigner/shells/pi/image/external/Config.in
```kconfig
source "$BR2_EXTERNAL_OPENSIGNER_PI_PATH/package/opensigner-pi/Config.in"
source "$BR2_EXTERNAL_OPENSIGNER_PI_PATH/package/waveshare-28dpi-overlays/Config.in"
```

## opensigner/shells/pi/image/external/package/opensigner-pi/Config.in
```kconfig
config BR2_PACKAGE_OPENSIGNER_PI
	bool "opensigner-pi"
	help
	  Install the prebuilt opensigner-pi binary as /usr/bin/opensigner-pi.

	  The binary is not built here: `just pi-bin` cross-compiles it on
	  the host as a static armv7 executable and the image build mounts
	  it into the container. Buildroot never sees the Rust toolchain.

if BR2_PACKAGE_OPENSIGNER_PI

config BR2_PACKAGE_OPENSIGNER_PI_BINARY
	string "path to the prebuilt binary"
	default "/binary/opensigner-pi"
	help
	  Absolute path, inside the build container, of the static armv7
	  opensigner-pi binary produced by `just pi-bin`.

endif
```

## opensigner/shells/pi/image/external/package/waveshare-28dpi-overlays/Config.in
```kconfig
config BR2_PACKAGE_WAVESHARE_28DPI_OVERLAYS
	bool "waveshare-28dpi-overlays"
	help
	  Waveshare's device tree overlays for the 2.8inch DPI LCD.

	  Downloaded from Waveshare's own file server, the pack their wiki
	  page links: https://www.waveshare.com/wiki/2.8inch_DPI_LCD
	  Three of the five overlays are installed into the boot
	  partition: the panel on a 3B/3B+, the 3B pin map, and the Goodix
	  touch controller on its bit-banged i2c bus.
```
